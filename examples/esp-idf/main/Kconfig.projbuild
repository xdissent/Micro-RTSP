## examples/esp-idf/main/Kconfig.projbuild
```kconfig
menu "ESP32CAM Configuration"

    config ESP_WIFI_SSID
        string "WiFi SSID"
        default "myssid"
        help
            SSID (network name) for the ESP32CAM to connect to.

    config ESP_WIFI_PASSWORD
        string "WiFi Password"
        default "mypassword"
        help
            WiFi password (WPA or WPA2) for the ESP32CAM to use.
endmenu
```
